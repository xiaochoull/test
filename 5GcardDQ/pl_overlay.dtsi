/*
 * CAUTION: This file is automatically generated by Xilinx.
 * Version: XSCT 2019.2
 * Today is: Mon Jun  8 18:05:54 2020
 */

/dts-v1/;
/plugin/;
  
/ {
  
    fragment@0 {
        target = <&fpga_full>;
        overlay0:__overlay__ {
            #address-cells = <2>;
            #size-cells = <2>;
//#define		ZYNQMP_RESET_PS_PL0		116
//https://xilinx-wiki.atlassian.net/wiki/spaces/A/pages/18841847/Solution+ZynqMP+PL+Programming
            firmware-name = "system.bit.bin";
	    //resets = <&zynqmp_reset 116>;
// /root/fpgautil -b /root/system.bit.bin -o /root/pl.dtbo
//cp /lib/firmware/* /root/

        };
    };
    
    fragment@1 {
        target = <&amba>;
        overlay1: __overlay__ {

		axi_iic_0: i2c@a0030000 {
			#address-cells = <1>;
			#size-cells = <0>;
			clock-names = "s_axi_aclk";
			clocks = <&zynqmp_clk 71>;
			compatible = "xlnx,axi-iic-2.0", "xlnx,xps-iic-2.00.a";
			interrupt-names = "iic2intc_irpt";
			interrupt-parent = <&gic>;
			interrupts = <0 91 4>;
			reg = <0x0 0xa0030000 0x0 0x10000>;
		};
		axi_uartlite_0: serial@a0010000 {
			clock-names = "s_axi_aclk";
			clocks = <&zynqmp_clk 71>;
			compatible = "xlnx,axi-uartlite-2.0", "xlnx,xps-uartlite-1.00.a";
			current-speed = <9600>;
			device_type = "serial";
			interrupt-names = "interrupt";
			interrupt-parent = <&gic>;
			interrupts = <0 89 1>;
			port-number = <0>;
			reg = <0x0 0xa0010000 0x0 0x10000>;
			xlnx,baudrate = <0x2580>;
			xlnx,data-bits = <0x8>;
			xlnx,odd-parity = <0x0>;
			xlnx,s-axi-aclk-freq-hz-d = "99.999001";
			xlnx,use-parity = <0x0>;
		};
        };
    };
};
